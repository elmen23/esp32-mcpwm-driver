## sdkconfig.defaults
```kconfig
# ── ESP32 MCPWM Driver — Minimal sdkconfig defaults ──

# Target chip
CONFIG_IDF_TARGET_ESP32=y

# Flash size (4 MB — matches standard ESP32 module)
CONFIG_ESPTOOLPY_FLASHSIZE_4MB=y

# Partition Table
CONFIG_PARTITION_TABLE_CUSTOM=y
CONFIG_PARTITION_TABLE_CUSTOM_FILENAME="partitions.csv"
CONFIG_PARTITION_TABLE_FILENAME="partitions.csv"

# WiFi — needed for AP mode
CONFIG_ESP_WIFI_ENABLED=y

# HTTP Server
CONFIG_HTTPD_MAX_REQ_HDR_LEN=512
CONFIG_HTTPD_MAX_URI_LEN=256

# FreeRTOS — optimise for responsive control
CONFIG_FREERTOS_HZ=1000
```
